## Kconfig
```kconfig
mainmenu "TagVFS Project Configuration"

source "src/Kconfig"
source "test/Kconfig"
```

## src/Kconfig
```kconfig
comment "Version metadata is not here!  See tv_version.py"

menu "Compiler options"

    config DEBUG
        bool "Debug mode (-g)"
        default n
        help
            Enables/disables compiler debug symbols.

            Needed for runtime debugging with gdb or equivalent; this sets the
            ``-g`` compiler flag and enables the BREAKPOINT macro and others.

    config DEBUG_BUILD
        bool "CMake debug mode"
        default n
        help
            Enables verbose makefiles (i.e., print compile commands as they're
            run).  Helpful for linker errors or messing with the build process.

    choice WARNING_VERBOSITY
        prompt "Warning strictness"
        default WARN_PEDANTIC
        help
            Defines warning control flags passed to the compiler.
        config WARN_SHUTUP
            bool "-fsyntax-only"
            help
                Only report (and break on) syntax errors.
        config WARN_NONE
            bool "-w (inhibit all warnings)"
            help
                Inhibit all warnings from being issued.
        config WARN_NORMAL
            bool "No warning control flags"
            help
                Default warning level; no extras, no inhibited.
        config WARN_WALL
            bool "-Wall"
            help
                Set the ``-Wall`` flag to the compiler.
        config WARN_WEXTRA
            bool "-Wall -Wextra"
            help
                Set the ``-Wall -Wextra`` flags to the compiler.
        config WARN_PEDANTIC
            bool "-Wall -Wextra -pedantic"
            help
                Set the ``-Wall -Wextra -pedantic`` flags to the compiler.
        config WARN_WERROR
            bool "-Wall -Wextra -pedantic -Werror"
            help
                Equivalent to ``-Wall -Wextra -pedantic`` but treat all
                warnings as errors.  This is the compiler's "expert difficulty"
                setting.
    endchoice

    choice COMPILER_OPTIMIZATION
        prompt "Compiler optimization level (-O<x>)"
        default OPT_NONE
        help
            Compiler optimization flag setting.
        config OPT_NONE
            bool "-O0 (no optimization)"
            help
                -O0 flag: no optimizations applied.
        config OPT_O1
            bool "-O1 (minimal opimization)"
            help
                -O1 (also -O) flag: minimal optimizations.
        config OPT_O2
            bool "-O2 (more optimization)"
            help
                -O2 flag: more optimizations.
        config OPT_O3
            bool "-O3 (even more optimization)"
            help
                -O3 flag: even more optimizations.
    endchoice

    config OPT_OFAST
        bool "-Ofast (maximum optimization) !DANGER!"
        default n
        help
            -Ofast flag: aggressive optimizations.  This may break compiler
            standards compliance; use with caution!

    config OPT_OG
        bool "-Og (debug)"
        default n
        depends on DEBUG
        help
            -Og flag: apply optimizations that do not interfere with
            debugging.

    config OPT_OS
        bool "-Os (optimize size)"
        default n
        help
            -Os flag: apply optimizations to reduce code size.

endmenu

menu "Program-wide constants"

    choice LOG_VERBOSITY
        prompt "Logging verbosity (max)"
        default TV_LOG_WARN
        help
            Sets log level for limiting logging macros.
        config TV_LOG_NONE
            bool "(0) None"
        config TV_LOG_ERR
            bool "(1) Error"
        config TV_LOG_WARN
            bool "(2) Warning"
        config TV_LOG_INFO
            bool "(3) Info"
        config TV_LOG_DEBUG
            bool "(4) Debug"
        config TV_LOG_VERBOSE
            bool "(5) Verbose"
    endchoice

    config LOG_LEVEL
        int
        default 0 if TV_LOG_NONE
        default 1 if TV_LOG_ERR
        default 2 if TV_LOG_WARN
        default 3 if TV_LOG_INFO
        default 4 if TV_LOG_DEBUG
        default 5 if TV_LOG_VERBOSE

    config TV_ERR_START
        int "TagVFS-specific error values start"
        default 540
        help
            Set this to number of system error codes (errno) plus one to avoid
            overlap.

    config SINKFILE
        string "Sinkfile"
        default "/dev/null"
        help
            A file that can have arbitrary data dumped into it with no
            consequence.  For linux systems, ideally /dev/null.

            This is used for redirecting output when unwanted (at time of
            creation, libxml2's error messages to stderr that I'd rather not
            have printed -- instead catch the error and process it).

endmenu

# Include the lower levels last (for organization only -- we want the debug
# option to be near the top and quick to get to)
source "src/tvwio/Kconfig"
source "src/tvcompression/Kconfig"
```

## src/format/Kconfig
```kconfig
menu "tvwio library"

    config FORMAT_VERSION
        int "Config file format version"
        default 0
        help    
            Integer version number of the format file specification supported
            by this version of TagVFS.

    config TVWIO_READ_SECURITY
        bool "tvw_i contents overread prevention"
        default y
        help
            Perform anti-overread checks in TVW read library.  Recommended for
            security reasons.

    config TVWMAKE_MAX_LINE_SIZE
        int "tvwmake max line size (read-until-EOF loop)"
        default 1024
        help
            Maximum size accepted by tvwmake executable's read-from-CLI loop,
            *in each line*.

    config TVWMAKE_MAX_META_SIZE
        int "tvwmake max metadata size"
        default 65536
        help
            Maximum buffer size for metadata input to tvwmake executable.

    config TVWMAKE_MAX_FILE_SIZE
        int "tvwmake max file readin size"
        default 65536
        help
            Maximum buffer size for file contents input to tvwmake executable.
            This only takes effect when prompting user for file contents via
            stdin; no maximum file size is applied if accepting an
            already-existing file as input.

    menu "tvw_i xml reading flags"

        comment "Flags of the xmlParserOption enum defined in libxml2"

        config TVWI_XF_RECOVER
            bool "RECOVER"
            default n

        config TVWI_XF_NOERROR
            bool "NOERROR"
            default n

        config TVWI_XF_NOWARNING
            bool "NOWARNING"
            default n

        config TVWI_XF_PEDANTIC
            bool "PEDANTIC"
            default y

        config TVWI_XF_NONET
            bool "NONET"
            default y

        config TVWI_XF_IGNORE_ENC
            bool "IGNORE_ENC"
            default n

        config TVW_XF_SUMMED
            int "test add"
            default 1 + 2

    endmenu

endmenu
```

## src/tvcompression/Kconfig
```kconfig
menu "tvcompression library"

    config TVCTOOL_MAX_CLI_INPUT_SIZE
        int "tvctool max CLI input buffer size"
        default 65536
        help
            Maximum buffer size for pre-operation data that may be accepted
            through STDIN input.

    menu "Enabled algorithms"

        comment "WARNING: Disabling everything may cause undefined behavior!"

        config TVCALG_NOCOMPRESSION
            bool "No compression"
            default y
            help
                Allow uncompressed data storage.  Please don't turn this off
                except for testing...

        config TVCALG_TABLETEST
            bool "Table test algorithm"
            default y
            help
                Enable the 1-shift Caesar cipher algorithm.  Intended for
                testing only.

    endmenu

endmenu
```

## src/tvwio/Kconfig
```kconfig
menu "tvwio library"

    config FORMAT_VERSION
        int "Config file format version"
        default 0
        help    
            Integer version number of the format file specification supported
            by this version of TagVFS.

    config TVWIO_READ_SECURITY
        bool "tvw_i contents overread prevention"
        default y
        help
            Perform anti-overread checks in TVW read library.  Recommended for
            security reasons.

    config TVWI_INVALID_XML_IS_FATAL
        bool "tvw_i die on invalid XML metadata"
        default y
        help
            Whether or not invalid XML in the metadata section should be
            considered a fatal error.

            If enabled, in this case, an error message is emitted and an error
            code (invalid metadata) is returned.

            If disabled, in this case, a warning message is emitted and the
            wrapper file struct's ``xmlroot`` property is NULL.  The as-read
            metadata section is still available in the ``metadata`` property.

    config TVWO_VALIDATE_XML
        bool "tvw_o die on invalid XML in metadata"
        default y
        help
            Whether or not the output side of tvwio lib should barf-and-die
            when asked to write knowingly-invalid XML into the metadata section
            of a wrapper file.  Recommended.

            If enabled, the metadata needs to be parsed before output and if
            the wrap->xmlroot value is NULL, tvw_write() will parse the
            metadata.  In this case, the parser will be given the same flags as
            the input parser, i.e., that of TVWI_XML_RD_FLAGS.

    config TVWMAKE_MAX_LINE_SIZE
        int "tvwmake max line size (read-until-EOF loop)"
        default 1024
        help
            Maximum size accepted by tvwmake executable's read-from-CLI loop,
            *in each line*.

    config TVWMAKE_MAX_META_SIZE
        int "tvwmake max metadata size"
        default 65536
        help
            Maximum buffer size for metadata input to tvwmake executable.

    config TVWMAKE_MAX_FILE_SIZE
        int "tvwmake max file readin size"
        default 65536
        help
            Maximum buffer size for file contents input to tvwmake executable.
            This only takes effect when prompting user for file contents via
            stdin; no maximum file size is applied if accepting an
            already-existing file as input.

    menu "tvw_i xml reading flags"

        comment "Flags of the xmlParserOption enum defined in libxml2"

        config TVWI_XF_RECOVER
            bool "RECOVER"
            default n

        config TVWI_XF_NOERROR
            bool "NOERROR"
            default n

        config TVWI_XF_NOWARNING
            bool "NOWARNING"
            default n

        config TVWI_XF_PEDANTIC
            bool "PEDANTIC"
            default y

        config TVWI_XF_NONET
            bool "NONET"
            default y

        config TVWI_XF_IGNORE_ENC
            bool "IGNORE_ENC"
            default n

    endmenu

endmenu
```

## test/Kconfig
```kconfig
menu "Testing"

    config COV_ENABLE 
        bool "Enable coverage analysis"
        default n
        help
            Enables the GCC flags and gcov linking to allow gcov analysis.
            This option is independent of unit testing; though enabling it in
            conjunction with unit testing allows analysis of what code is
            covered by the unit testing.

    config UT_ENABLE
        bool "Enable unit testing builds"
        default n
        help
            Enables the compilation of unit tests.

    config CRITERION_INCLUDE_PATH
        string "Criterion include path"
        help
            Include path for Criterion library.  Should be absolute for best
            results.

endmenu
```
